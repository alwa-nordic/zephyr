/* Copyright (c) 2024 Nordic Semiconductor ASA
 * SPDX-License-Identifier: Apache-2.0
 */

/ {
	chosen {
		zephyr,console = &zephyr_console_uart;
	};
};

zephyr_console_uart: &uart0 {};

&zephyr_console_uart {
	status = "okay";
	current-speed = <1000000>;
};
