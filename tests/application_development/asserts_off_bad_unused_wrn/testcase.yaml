## tests/application_development/asserts_off_bad_unused_wrn/testcase.yaml
```yaml
tests:
  application_development.asserts_off_bad_unused_wrn:
    build_only: true
```

## tests/bluetooth/host_scan_reassembler/testcase.yaml
```yaml
tests:
  bluetooth.host.scan.reassembler:
    tags:
      - bluetooth
    harness: ztest
    platform_allow:
      - native_sim
    integration_platforms:
      - native_sim
```
