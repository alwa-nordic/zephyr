## prj.conf
```kconfig
CONFIG_BT=y
CONFIG_BT_BROADCASTER=y
CONFIG_BT_CENTRAL=y
CONFIG_BT_OBSERVER=y
CONFIG_BT_EXT_ADV=y
CONFIG_BT_DEVICE_NAME="Scanner Test"

# Enable privacy with frequent address refreshes
CONFIG_BT_SMP=y
CONFIG_BT_PRIVACY=y
CONFIG_BT_RPA_TIMEOUT=2

# Log & debug options
CONFIG_LOG=y
CONFIG_LOG_RUNTIME_FILTERING=y
CONFIG_LOG_THREAD_ID_PREFIX=y

CONFIG_ASSERT=y
CONFIG_THREAD_NAME=y
CONFIG_LOG_THREAD_ID_PREFIX=y
CONFIG_ARCH_POSIX_TRAP_ON_FATAL=y

CONFIG_BT_EXT_SCAN_BUF_SIZE=1650
```

## bt-ctlr.conf
```kconfig
# This file contains the configuration for the Bluetooth
# controller. It is in a separate file so that the controller
# may be built in a separate image.

CONFIG_BT_EXT_ADV=y

CONFIG_BT_LL_SW_SPLIT=y

CONFIG_BT_BROADCASTER=y
# ZLL allow experimental flags
CONFIG_BT_CTLR_ADVANCED_FEATURES=y
# ZLL experimental flag to allow the spec max
CONFIG_BT_CTLR_ADV_DATA_CHAIN=y
# Max allowed by spec
CONFIG_BT_CTLR_ADV_DATA_LEN_MAX=1650

CONFIG_BT_OBSERVER=y
# Max allowed by spec
CONFIG_BT_CTLR_SCAN_DATA_LEN_MAX=1650
```

## src/dut.c
```c
/* Copyright (c) 2024 Nordic Semiconductor ASA
 * SPDX-License-Identifier: Apache-2.0
 */

#include <zephyr/bluetooth/addr.h>
#include <zephyr/bluetooth/bluetooth.h>
#include <zephyr/kernel.h>
#include <zephyr/logging/log.h>
#include <zephyr/sys/atomic.h>
#include <zephyr/sys/atomic_builtin.h>

#include "testlib/log_utils.h"
#include "babblekit/flags.h"
#include "babblekit/testcase.h"

LOG_MODULE_REGISTER(dut, LOG_LEVEL_DBG);

extern unsigned long runtime_log_level;

static void device_found(const bt_addr_le_t *addr, int8_t rssi, uint8_t type,
			 struct net_buf_simple *ad)
{
	char addr_str[BT_ADDR_LE_STR_LEN];

	k_msleep(500); /* simulate a slow memcpy (or user processing the scan data) */

	bt_addr_le_to_str(addr, addr_str, sizeof(addr_str));
	LOG_INF("Device found: %s (RSSI %d), type %u, AD data len %u", addr_str, rssi, type,
		ad->len);
}

#define BT_LE_SCAN_ACTIVE_CONTINUOUS_WITH_DUPLICATES                                               \
	BT_LE_SCAN_PARAM(BT_LE_SCAN_TYPE_ACTIVE, 0, BT_GAP_SCAN_FAST_INTERVAL_MIN,                 \
			 BT_GAP_SCAN_FAST_WINDOW)

void entrypoint_dut(void)
{
	/* Test purpose:
	 *
	 * Verifies that the host can handle running out of HCI RX buffers.
	 *
	 * To test this, we use a scanner with privacy enabled and sleep a bit
	 * when we get every advertising report. This sleep period simulates a
	 * slow "memcpy" operation on actual hardware. In effect, this uses up
	 * the event buffer pools.
	 *
	 * A short RPA timeout is used to prompt the host into periodically
	 * sending a bunch of commands to the controller. Those commands should
	 * not fail.
	 *
	 * Note: This test only fails by the stack crashing.
	 *
	 * It is a regression test for
	 * https://github.com/zephyrproject-rtos/zephyr/issues/78223
	 *
	 * Two devices:
	 * - `dut`: active-scans with privacy ON
	 * - `peer`: bog-standard advertiser
	 *
	 * [verdict]
	 * - dut is able to run for a long enough time without triggering asserts
	 */
	int err;

	TEST_START("DUT");

	/* Set the log level given by the `log_level` CLI argument */
	bt_testlib_log_level_set("dut", runtime_log_level);

	err = bt_enable(NULL);
	TEST_ASSERT(!err, "Bluetooth init failed (err %d)\n", err);

	LOG_DBG("Bluetooth initialised");

	err = bt_le_scan_start(BT_LE_SCAN_ACTIVE_CONTINUOUS_WITH_DUPLICATES, device_found);
	TEST_ASSERT(!err, "Scanner setup failed (err %d)\n", err);
	LOG_DBG("Explicit scanner started");

	/* 40 seconds ought to be enough for anyone */
	k_sleep(K_SECONDS(40));

	TEST_PASS_AND_EXIT("DUT passed");
}
```

## src/peer.c
```c
/* Copyright (c) 2024 Nordic Semiconductor ASA
 * SPDX-License-Identifier: Apache-2.0
 */

#include <zephyr/bluetooth/addr.h>
#include <zephyr/bluetooth/bluetooth.h>
#include <zephyr/kernel.h>
#include <zephyr/logging/log.h>
#include <zephyr/sys/atomic.h>
#include <zephyr/sys/atomic_builtin.h>

#include "testlib/log_utils.h"
#include "babblekit/flags.h"
#include "babblekit/testcase.h"
#include <stdint.h>

LOG_MODULE_REGISTER(peer, LOG_LEVEL_DBG);

extern unsigned long runtime_log_level;

static const char very_long_name[] = "0 Very Long Name"
				     "0123456789abcdef"
				     "1 Very Long Name"
				     "0123456789abcdef"

				     "2 Very Long Name"
				     "0123456789abcdef"
				     "3 Very Long Name"
				     "0123456789abcdef"

				     "4 Very Long Name"
				     "0123456789abcdef"
				     "5 Very Long Name"
				     "0123456789abcdef"

				     "6 Very Long Name"
				     "0123456789abcdef"
				     "7 Very Long Name"
				     "01234567";


static const char very_long_ead[] = "asdfasdfasdfsadfasdfsadfsadfsadfsdfasfd";

void entrypoint_peer(void)
{
	int err;
	struct bt_data ad[] = {
		{
			.type = BT_DATA_NAME_COMPLETE,
			.data = very_long_name,
			.data_len = strlen(very_long_name),
		},
		{
			.type = BT_DATA_ENCRYPTED_AD_DATA,
			.data = very_long_ead,
			.data_len = strlen(very_long_ead),
		},
	};

	TEST_START("peer");

	/* Set the log level given by the `log_level` CLI argument */
	bt_testlib_log_level_set("peer", runtime_log_level);

	err = bt_enable(NULL);
	TEST_ASSERT(!err, "Bluetooth init failed (err %d)\n", err);

	LOG_DBG("Bluetooth initialised");

	struct bt_le_ext_adv *adv;

	struct bt_le_adv_param adv_param = BT_LE_ADV_PARAM_INIT(
		BT_LE_ADV_OPT_EXT_ADV, BT_GAP_ADV_FAST_INT_MIN_1, BT_GAP_ADV_FAST_INT_MAX_1, NULL);

	err = bt_le_ext_adv_create(&adv_param, NULL, &adv);
	TEST_ASSERT(!err, "Failed to create advertising set: %d", err);
	LOG_DBG("Created extended advertising set.");

	err = bt_le_ext_adv_set_data(adv, ad, ARRAY_SIZE(ad), NULL, 0);
	TEST_ASSERT(!err, "Failed to set advertising data: %d", err);
	LOG_DBG("Set advertising data.");

	err = bt_le_ext_adv_start(adv, BT_LE_EXT_ADV_START_DEFAULT);
	TEST_ASSERT(!err, "Failed to start extended advertising: %d", err);
	LOG_DBG("Started extended advertising.");

	TEST_PASS("Tester done");
}
```
